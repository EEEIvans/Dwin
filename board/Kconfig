## board/Kconfig
```kconfig
menu "Hardware Drivers Config"

config SOC_STM32F412RE
    bool
    select SOC_SERIES_STM32F4
    select RT_USING_COMPONENTS_INIT
    select RT_USING_USER_MAIN
    default y

menu "On-chip Peripheral Drivers"

    config BSP_USING_GPIO
        bool "Enable GPIO"
        select RT_USING_PIN
        default y

    menuconfig BSP_USING_UART
        bool "Enable UART"
        default y
        select RT_USING_SERIAL
        if BSP_USING_UART
            config BSP_USING_UART1
                bool "Enable UART1"
                default y
			
            config BSP_UART1_RX_USING_DMA
                bool "Enable UART1 RX DMA"
                depends on BSP_USING_UART1 && RT_SERIAL_USING_DMA
                default n
			
			if BSP_USING_UART1 && RT_USING_SERIAL_V2
				config BSP_UART1_RX_BUFSIZE
				int "UART1 RX BUFFER SIZE"
				default 256
				
				config BSP_UART1_TX_BUFSIZE
				int "UART1 TX BUFFER SIZE"
				default 0
			endif

            config BSP_USING_UART2
                bool "Enable UART2"
                default y
			
            config BSP_UART2_RX_USING_DMA
                bool "Enable UART2 RX DMA"
                depends on BSP_USING_UART2 && RT_SERIAL_USING_DMA
                default n
			
			if BSP_USING_UART2 && RT_USING_SERIAL_V2
				config BSP_UART2_RX_BUFSIZE
				int "UART2 RX BUFFER SIZE"
				default 256
				
				config BSP_UART2_TX_BUFSIZE
				int "UART2 TX BUFFER SIZE"
				default 0
			endif

            config BSP_USING_UART3
                bool "Enable UART3"
                default y
			
            config BSP_UART3_RX_USING_DMA
                bool "Enable UART3 RX DMA"
                depends on BSP_USING_UART3 && RT_SERIAL_USING_DMA
                default n
			
			if BSP_USING_UART3 && RT_USING_SERIAL_V2
				config BSP_UART3_RX_BUFSIZE
				int "UART3 RX BUFFER SIZE"
				default 256
				
				config BSP_UART3_TX_BUFSIZE
				int "UART3 TX BUFFER SIZE"
				default 0
			endif
        endif

    menuconfig BSP_USING_CAN
        bool "Enable CAN"
        default n
        select RT_USING_CAN
        if BSP_USING_CAN
            config BSP_USING_CAN1
                bool "Enable CAN1"
                default n
				
			if BSP_USING_CAN1
				config INTERFACE_CFG_CAN_NAME
				string "CAN name"
				default "can1"
				
				config INTERFACE_CFG_CAN_THREAD_PRO
				int "CAN Thread priority"
				default 20
				
				config INTERFACE_CFG_CAN_THREAD_SIZE
				int "CAN Thread stack size"
				default 1024
				
				config INTERFACE_CFG_CAN_THREAD_CPU_SECTION
				int "CAN Thread CPU section"
				default 20
			endif

            config BSP_USING_CAN2
                bool "Enable CAN2"
                default n
        endif

endmenu

endmenu
```
